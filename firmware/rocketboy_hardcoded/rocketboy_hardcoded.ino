// RocketBoy - hard-coded demo route (no sensors).  Same route / durations / soft-start as simulation/run_all.py (S5).
//
// Board:  ESP32 DevKit (38 pin) in the U10 socket of RocketBoy.kicad_pcb.  Arduino-ESP32 core 2.x or 3.x.
// Wiring (from the schematic):   left motor  = TB6612 channel A   right motor = channel B
//   PWMA  GPIO13   AIN1 GPIO12   AIN2 GPIO14
//   PWMB  GPIO27   BIN1 GPIO25   BIN2 GPIO26
// STBY is not driven by the ESP32: switch SW1 (and SW2/SW3 if wanted) to ON before powering the motors.
// If the robot drives backwards or turns right instead of left, swap the two wires of that motor (or flip DIR_* below).
//
// NOT TESTED ON HARDWARE - the numbers come from the simulation. Lift the robot off the floor for the first run.
#include <Arduino.h>
#include "route.h"                      // generated by simulation/run_all.py

static const int PWMA = 13, AIN1 = 12, AIN2 = 14;
static const int PWMB = 27, BIN1 = 25, BIN2 = 26;
static const int DIR_LEFT = +1, DIR_RIGHT = +1;       // flip to -1 to reverse a motor in software
static const int PWM_HZ = 20000, PWM_BITS = 10;
static const unsigned long CTRL_MS = 5;               // control period = simulation DT_CTRL

#if defined(ESP_ARDUINO_VERSION_MAJOR) && ESP_ARDUINO_VERSION_MAJOR >= 3
  #define PWM_ATTACH(pin) ledcAttach(pin, PWM_HZ, PWM_BITS)
  #define PWM_WRITE(pin, v) ledcWrite(pin, v)
#else
  #define PWM_ATTACH(pin) do { ledcSetup((pin) == PWMA ? 0 : 1, PWM_HZ, PWM_BITS); ledcAttachPin(pin, (pin) == PWMA ? 0 : 1); } while (0)
  #define PWM_WRITE(pin, v) ledcWrite((pin) == PWMA ? 0 : 1, v)
#endif

static void setMotor(float duty, int dirSign, int pwmPin, int in1, int in2) {
  duty *= dirSign;
  if (duty > 1) duty = 1; if (duty < -1) duty = -1;
  if (fabsf(duty) < 0.005f) {            // coast (IN1 = IN2 = LOW), same as the simulation
    digitalWrite(in1, LOW); digitalWrite(in2, LOW); PWM_WRITE(pwmPin, 0); return;
  }
  digitalWrite(in1, duty > 0 ? HIGH : LOW);
  digitalWrite(in2, duty > 0 ? LOW : HIGH);
  PWM_WRITE(pwmPin, (uint32_t)(fabsf(duty) * ((1 << PWM_BITS) - 1)));
}

void setup() {
  Serial.begin(115200);
  pinMode(AIN1, OUTPUT); pinMode(AIN2, OUTPUT); pinMode(BIN1, OUTPUT); pinMode(BIN2, OUTPUT);
  PWM_ATTACH(PWMA); PWM_ATTACH(PWMB);
  setMotor(0, 1, PWMA, AIN1, AIN2); setMotor(0, 1, PWMB, BIN1, BIN2);
  Serial.println("RocketBoy hard-coded route starts in 3 s (SW1 must be ON)");
  delay(3000);
}

void loop() {
  static bool done = false;
  if (done) { delay(1000); return; }
  float ul = 0, ur = 0;
  for (size_t i = 0; i < sizeof(ROUTE) / sizeof(ROUTE[0]); i++) {
    Serial.println(ROUTE[i].name);
    unsigned long t0 = millis(), next = t0;
    while (millis() - t0 < ROUTE[i].ms) {
      const float step = SLEW_PER_S * CTRL_MS / 1000.0f;                     // duty slew limit = soft start
      ul += constrain(ROUTE[i].left  - ul, -step, step);
      ur += constrain(ROUTE[i].right - ur, -step, step);
      setMotor(ul, DIR_LEFT,  PWMA, AIN1, AIN2);
      setMotor(ur, DIR_RIGHT, PWMB, BIN1, BIN2);
      next += CTRL_MS;
      while ((long)(millis() - next) < 0) { delay(1); }
    }
  }
  setMotor(0, 1, PWMA, AIN1, AIN2); setMotor(0, 1, PWMB, BIN1, BIN2);
  Serial.println("done");
  done = true;
}
